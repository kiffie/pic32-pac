# PIC32MZ2048EFM144 register map
Registers are 32-bit, access not given, reset 0x0 unless marked. A register's access mark holds for its fields unless they carry their own. Offsets are from the block's base; lines under a group give offsets from that group; [hi:lo] are bit positions; {n}, {i} and the like mark numbered series; 'fields as' and 'values as' point back to an identical list; <NAME> marks a mode.

## Memory map
0xBF800000 CFG size 0xF0 — CFG peripheral
0xBF800600 NVM size 0xB0 — NVM peripheral
0xBF800800 WDT size 0x10 — WDT peripheral
0xBF800A00 DMT size 0x80 — DMT peripheral
0xBF800C00 RTCC size 0x60 — RTCC peripheral
0xBF800E00 CVR size 0x10 — CVR peripheral
0xBF801130 ICD size 0x10 — ICD peripheral
0xBF801140 _DDPSTAT size 0x10 — _DDPSTAT peripheral
0xBF801200 CRU size 0x1E0 — CRU peripheral
0xBF801404 PPS size 0x2B0 — PPS peripheral
0xBF810000 INT size 0x1060 — INT peripheral
0xBF811060 DMAC size 0x600 — DMAC peripheral
0xBF820000 I2C1 size 0x70 — I2C1 peripheral
0xBF820200 I2C2 size 0x70 — I2C2 peripheral
0xBF820400 I2C3 size 0x70 — I2C3 peripheral
0xBF820600 I2C4 size 0x70 — I2C4 peripheral
0xBF820800 I2C5 size 0x70 — I2C5 peripheral
0xBF821000 SPI1 size 0x50 — SPI1 peripheral
0xBF821200 SPI2 size 0x50 — SPI2 peripheral
0xBF821400 SPI3 size 0x50 — SPI3 peripheral
0xBF821600 SPI4 size 0x50 — SPI4 peripheral
0xBF821800 SPI5 size 0x50 — SPI5 peripheral
0xBF821A00 SPI6 size 0x50 — SPI6 peripheral
0xBF822000 UART1 size 0x50 — UART1 peripheral
0xBF822200 UART2 size 0x50 — UART2 peripheral
0xBF822400 UART3 size 0x50 — UART3 peripheral
0xBF822600 UART4 size 0x50 — UART4 peripheral
0xBF822800 UART5 size 0x50 — UART5 peripheral
0xBF822A00 UART6 size 0x50 — UART6 peripheral
0xBF82E000 PMP size 0xA0 — PMP peripheral
{0xBF83FE00+0x200*n} TMR{n} size 0x30 (n=1..9) — TMR{n} peripheral
{0xBF841E00+0x200*n} ICAP{n} size 0x20 (n=1..9) — ICAP{n} peripheral
{0xBF843E00+0x200*n} OCMP{n} size 0x30 (n=1..9) — OCMP{n} peripheral
0xBF84B000 ADCHS size 0x2C0 — ADCHS peripheral
0xBF84C000 CMP1 size 0x10 — CMP1 peripheral
0xBF84C010 CMP2 size 0x10 — CMP2 peripheral
0xBF84C060 CMP size 0x10 — CMP peripheral
0xBF860000 PORTA size 0xE0 — PORTA peripheral
0xBF860100 PORTB size 0xE0 — PORTB peripheral
0xBF860200 PORTC size 0xC0 — PORTC peripheral
0xBF860300 PORTD size 0xC0 — PORTD peripheral
0xBF860400 PORTE size 0xE0 — PORTE peripheral
0xBF860500 PORTF size 0xE0 — PORTF peripheral
0xBF860600 PORTG size 0xE0 — PORTG peripheral
0xBF860700 PORTH size 0xC0 — PORTH peripheral
0xBF860800 PORTJ size 0xC0 — PORTJ peripheral
0xBF860910 PORTK size 0xB0 — PORTK peripheral
0xBF880000 CAN1 size 0xB50 — CAN1 peripheral
0xBF881000 CAN2 size 0xB50 — CAN2 peripheral
0xBF882000 ETH size 0x330 — ETH peripheral
0xBF884000 USBCRCON size 0x10 — USBCRCON peripheral
0xBF8E0000 PCACHE size 0x20 — PCACHE peripheral
0xBF8E1014 EBI size 0xA0 — EBI peripheral
0xBF8E2000 SQI1 size 0x78 — SQI1 peripheral
0xBF8E3000 USB size 0x374 — USB peripheral
0xBF8E5000 CRYPTO size 0x34 — CRYPTO peripheral
0xBF8E6000 RNG size 0x30 — RNG peripheral
0xBF8F0510 SB size 0xAF58 — SB peripheral

## Interrupts
0 CORE_TIMER (INT)
1 CORE_SOFTWARE_0 (INT)
2 CORE_SOFTWARE_1 (INT)
3 EXTERNAL_0 (INT)
4 TIMER_1 (INT)
5 INPUT_CAPTURE_1_ERROR (INT)
6 INPUT_CAPTURE_1 (INT)
7 OUTPUT_COMPARE_1 (INT)
8 EXTERNAL_1 (INT)
9 TIMER_2 (INT)
10 INPUT_CAPTURE_2_ERROR (INT)
11 INPUT_CAPTURE_2 (INT)
12 OUTPUT_COMPARE_2 (INT)
13 EXTERNAL_2 (INT)
14 TIMER_3 (INT)
15 INPUT_CAPTURE_3_ERROR (INT)
16 INPUT_CAPTURE_3 (INT)
17 OUTPUT_COMPARE_3 (INT)
18 EXTERNAL_3 (INT)
19 TIMER_4 (INT)
20 INPUT_CAPTURE_4_ERROR (INT)
21 INPUT_CAPTURE_4 (INT)
22 OUTPUT_COMPARE_4 (INT)
23 EXTERNAL_4 (INT)
24 TIMER_5 (INT)
25 INPUT_CAPTURE_5_ERROR (INT)
26 INPUT_CAPTURE_5 (INT)
27 OUTPUT_COMPARE_5 (INT)
28 TIMER_6 (INT)
29 INPUT_CAPTURE_6_ERROR (INT)
30 INPUT_CAPTURE_6 (INT)
31 OUTPUT_COMPARE_6 (INT)
32 TIMER_7 (INT)
33 INPUT_CAPTURE_7_ERROR (INT)
34 INPUT_CAPTURE_7 (INT)
35 OUTPUT_COMPARE_7 (INT)
36 TIMER_8 (INT)
37 INPUT_CAPTURE_8_ERROR (INT)
38 INPUT_CAPTURE_8 (INT)
39 OUTPUT_COMPARE_8 (INT)
40 TIMER_9 (INT)
41 INPUT_CAPTURE_9_ERROR (INT)
42 INPUT_CAPTURE_9 (INT)
43 OUTPUT_COMPARE_9 (INT)
44 ADC (INT)
45 ADC_FIFO (INT)
46 ADC_DC1 (INT)
47 ADC_DC2 (INT)
48 ADC_DC3 (INT)
49 ADC_DC4 (INT)
50 ADC_DC5 (INT)
51 ADC_DC6 (INT)
52 ADC_DF1 (INT)
53 ADC_DF2 (INT)
54 ADC_DF3 (INT)
55 ADC_DF4 (INT)
56 ADC_DF5 (INT)
57 ADC_DF6 (INT)
58 ADC_FAULT (INT)
{n+59} ADC_DATA{n} (INT) (n=0..44)
104 CORE_PERF_COUNT (INT)
105 CORE_FAST_DEBUG_CHAN (INT)
106 SYSTEM_BUS_PROTECTION (INT)
107 CRYPTO (INT)
109 SPI1_FAULT (INT)
110 SPI1_RX (INT)
111 SPI1_TX (INT)
112 UART1_FAULT (INT)
113 UART1_RX (INT)
114 UART1_TX (INT)
115 I2C1_BUS (INT)
116 I2C1_SLAVE (INT)
117 I2C1_MASTER (INT)
118 CHANGE_NOTICE_A (INT)
119 CHANGE_NOTICE_B (INT)
120 CHANGE_NOTICE_C (INT)
121 CHANGE_NOTICE_D (INT)
122 CHANGE_NOTICE_E (INT)
123 CHANGE_NOTICE_F (INT)
124 CHANGE_NOTICE_G (INT)
125 CHANGE_NOTICE_H (INT)
126 CHANGE_NOTICE_J (INT)
127 CHANGE_NOTICE_K (INT)
128 PMP (INT)
129 PMP_ERROR (INT)
130 COMPARATOR_1 (INT)
131 COMPARATOR_2 (INT)
132 USB (INT)
133 USB_DMA (INT)
{n+134} DMA{n} (INT) (n=0..7)
142 SPI2_FAULT (INT)
143 SPI2_RX (INT)
144 SPI2_TX (INT)
145 UART2_FAULT (INT)
146 UART2_RX (INT)
147 UART2_TX (INT)
148 I2C2_BUS (INT)
149 I2C2_SLAVE (INT)
150 I2C2_MASTER (INT)
151 CAN1 (INT)
152 CAN2 (INT)
153 ETHERNET (INT)
154 SPI3_FAULT (INT)
155 SPI3_RX (INT)
156 SPI3_TX (INT)
157 UART3_FAULT (INT)
158 UART3_RX (INT)
159 UART3_TX (INT)
160 I2C3_BUS (INT)
161 I2C3_SLAVE (INT)
162 I2C3_MASTER (INT)
163 SPI4_FAULT (INT)
164 SPI4_RX (INT)
165 SPI4_TX (INT)
166 RTCC (INT)
167 FLASH_CONTROL (INT)
168 PREFETCH (INT)
169 SQI1 (INT)
170 UART4_FAULT (INT)
171 UART4_RX (INT)
172 UART4_TX (INT)
173 I2C4_BUS (INT)
174 I2C4_SLAVE (INT)
175 I2C4_MASTER (INT)
176 SPI5_FAULT (INT)
177 SPI5_RX (INT)
178 SPI5_TX (INT)
179 UART5_FAULT (INT)
180 UART5_RX (INT)
181 UART5_TX (INT)
182 I2C5_BUS (INT)
183 I2C5_SLAVE (INT)
184 I2C5_MASTER (INT)
185 SPI6_FAULT (INT)
186 SPI6_RX (INT)
187 SPI6_TX (INT)
188 UART6_FAULT (INT)
189 UART6_RX (INT)
190 UART6_TX (INT)
192 ADC_EOS (INT)
193 ADC_ARDY (INT)
194 ADC_URDY (INT)
196 ADC_EARLY (INT)
198 ADC0_EARLY (INT)
199 ADC1_EARLY (INT)
200 ADC2_EARLY (INT)
201 ADC3_EARLY (INT)
202 ADC4_EARLY (INT)
205 ADC7_EARLY (INT)
206 ADC0_WARM (INT)
207 ADC1_WARM (INT)
208 ADC2_WARM (INT)
209 ADC3_WARM (INT)
210 ADC4_WARM (INT)
213 ADC7_WARM (INT)
